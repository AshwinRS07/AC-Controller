//Libraries
#include <IRrecv.h>
#include <IRremoteESP8266.h>
#include <IRsend.h>
#include <ir_Coolix.h>
#include <ir_Samsung.h>
#include <SoftwareSerial.h>
#include <ArduinoJson.h>
#include<ESP8266WiFi.h>
#include<ESP8266WebServer.h>

//Instances
SoftwareSerial s(D6,D5);
const int IRLED = 4;
//const int IRSensor = D1;
float temp = 0.0;
float humi = 0.0;
float heatIndex = 0.0;
const int idealTemp = 25;
int TempFlag = 1;
IRsend irsend(IRLED);
IRSamsungAc ac(IRLED);

//Soft Access Point Details
const char *ssid = "NodeMCU";
const char *password = "12345678";

IPAddress local_ip(192,168,2,1);
IPAddress gateway(192,168,2,1);
IPAddress subnet(255,255,255,0);

ESP8266WebServer server(80);


//AC IR Commands-Samsung/coolix
uint16_t ACOn[] = {4356, 4416,  518, 1622,  518, 578,  518, 1624,  518, 1650,  516, 552,  518,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 1648,  518};  // COOLIX B23F20
uint16_t ACOff[] = {4350, 4446,  486, 1630,  510, 584,  512, 1630,  512, 1656,  510, 554,  516,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 1648,  518};  // COOLIX B27BE0
uint16_t T17[] = {4356, 4416,  518, 1622,  518, 578,  518, 1622,  518, 1626,  542, 552,  518,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 1650,  518};  // COOLIX B23F00
uint16_t T18[] = {4356, 4416,  518, 1622,  518, 578,  518, 1624,  518, 1648,  518, 552,  518,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 1648,  518};  // COOLIX B23F10
uint16_t T19[] = {4358, 4416,  518, 1622,  518, 578,  518, 1622,  518, 1650,  518, 552,  518,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 1648,  518};  // COOLIX B23F30
uint16_t T20[] = {4354, 4416,  518, 1624,  518, 578,  518, 1622,  518, 1650,  518, 552,  518,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 1650,  518};  // COOLIX B23F20
uint16_t T21[] = {4356, 4416,  518, 1624,  516, 578,  518, 1622,  518, 1650,  518, 552,  518,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 1648,  518};  // COOLIX B23F60
uint16_t T22[] = {4356, 4418,  518, 1622,  518, 578,  518, 1622,  518, 1648,  518, 552,  518,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 1648,  518};  // COOLIX B23F70
uint16_t T23[] = {4356, 4418,  518, 1624,  518, 578,  518, 1622,  518, 1650,  518, 552,  518,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 1648,  518};  // COOLIX B23F50
uint16_t T24[] = {4358, 4418,  516, 1624,  516, 578,  518, 1624,  516, 1648,  518, 552,  518,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 1650,  518};  // COOLIX B23F40
uint16_t T25[] = {4358, 4416,  518, 1624,  518, 578,  518, 1622,  518, 1648,  518, 552,  518,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 1648,  518};  // COOLIX B23FC0
uint16_t T26[] = {4358, 4416,  518, 1624,  516, 578,  520, 1622,  518, 1648,  518, 552,  518,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 1650,  518};  // COOLIX B23FD0
uint16_t T27[] = {4356, 4418,  516, 1624,  518, 578,  518, 1622,  518, 1650,  518, 552,  518,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 1650,  516};  // COOLIX B23F90
uint16_t T28[] = {4356, 4418,  518, 1624,  516, 578,  518, 1622,  518, 1648,  518, 552,  518,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 1650,  518};  // COOLIX B23F80
uint16_t T29[] = {4358, 4416,  518, 1622,  518, 556,  538, 1624,  518, 1648,  518, 552,  516,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 1648,  518};  // COOLIX B23FA0
uint16_t T30[] = {4356, 4418,  518, 1622,  518, 578,  518, 1624,  516, 1650,  516, 552,  518,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 1650,  518};  // COOLIX B23FB0


//Setup - runs once
void setup() {

  ac.begin();

  //Initializing pins and sensors
  Serial.begin(9600);
  s.begin(9600);
  pinMode(IRLED,OUTPUT);
//  pinMode(IRSensor,INPUT);
  irsend.begin();

  //Initializing WiFi AP
  WiFi.softAP(ssid,password);
  WiFi.softAPConfig(local_ip,gateway,subnet);
  delay(100);

  server.on("/",handle_onConnect);
  server.on("/belowIdeal",handle_belowIdeal);
  server.on("/aboveIdeal",handle_aboveIdeal);
  server.on("/onIdeal",handle_onIdeal);
  server.onNotFound(handle_notFound);

  server.begin();
  Serial.println("HTTP Server Started");

  //Waiting to confirm serial connection with Arduino UNO
  while(!Serial){
    Serial.print("Getting Serial");
    continue;
  }
}

//Loop - runs on a loop indefinitely
void loop() {

  //Server code

  server.handleClient();
  if(TempFlag < idealTemp)
  {
    
  }


  
  //Receiving stats from DHT22 connected to Arduino UNO
  StaticJsonBuffer<1000> jsonBuffer;
  JsonObject& root = jsonBuffer.parseObject(s);

  //For incorrect/invalid data
  if(root == JsonObject::invalid()){
   // Serial.println("Invalid");
    return;
  }

  //Print stats
  Serial.println("JSON received and parsed");
  //root.prettyPrintTo(Serial);
  Serial.println("");
  Serial.print("Temperature:");
  temp = root["temp"];
  Serial.println(temp);
  Serial.print("Humidity:");
  humi = root["humidity"];
  Serial.println(humi);
  Serial.print("Heat Index:");
  heatIndex = root["heatIndex"];
  Serial.println(heatIndex);
  Serial.println("");
  Serial.println("-----------------------xxxxxxxx-----------------------");
  Serial.println("");
     
     
  /*   
     if (Serial.available() > 0) {
//     Serial.write(Serial.read());
     byte x = Serial.read();
    // Serial.println((char)x);
     temp=(char)x;
     //temp=(float)x;
     Serial.print("Temperature:");
     Serial.println(temp);
  //   humi = (float)x;
  //   Serial.print("Humidity:");
//     Serial.println(humi);
   }
   */

//Sending Signals via IR LED

if(temp < idealTemp-2){
//  Serial.println("yay");
  irsend.sendRaw(ACOff, 199, 38);
  Serial.println("Sent1");
}
else if(temp > idealTemp+2){
  irsend.sendRaw(ACOn,199,38);
  Serial.println("Sent2");
}
else{
  irsend.sendRaw(ACOff, 199, 38);
  /*
  irsend.sendRaw(ACOn,199,38);
  delay(5000);
  irsend.sendRaw(T25,199,38);
  //delay(5000);
  //ac.setTemp(25);
  Serial.println("Sent3");*/
}
delay(5000);
 }

void handle_onConnect(){
  server.send(200,"text/html",sendHTML(1));
}

void handle_belowIdeal(){
  server.send(200,"text/html",sendHTML(0));
}

void handle_aboveIdeal(){
  server.send(200,"text/html",sendHTML(2));
}

void handle_onIdeal(){
  server.send(200,"text/html",sendHTML(1));
}

void handle_notFound(){
  server.send(404,"text/plain","Not Found");
}

String sendHTML(int TempFlag){
  String ptr = "<!DOCTYPE HTML>\n";
  ptr += "<html>\n<head>\n<title>AC Controller</title>\n</head>\n";
  ptr += "<body>";
  ptr += "<h1>AC Controller</h1>\n";
  ptr += "<p>Manual Control</p>";
  ptr += "<form method=\"get\">\n";
  if(TempFlag == 1 || TempFlag == 2)
  {
    ptr += "<input type = \"button\" value = \"Lower Temperature\" onclick=\"window.location.href='/belowIdeal'\">\n";
    ptr += "<input type = \"button\" value = \"Automatic\" onclick=\"window.location.href='/onIdeal'\">\n";
    ptr += "<input type = \"button\" value = \"Raise Temperature\" onclick=\"window.location.href='/belowIdeal'\" disabled>\n";
  }
  else if(TempFlag == 2){
    ptr += "<input type = \"button\" value = \"Cool\" onclick=\"window.location.href='/aboveIdeal'\">\n";    
  }
  else{
    
  }
  ptr += "</form>";
  ptr += "</body>\n</html>";
  return ptr;
}
